SECTIONS {
    /* 内核虚拟地址基地址 */
    . = 0x80200000,
    /* 内核入口 */
    kernel_entry = .;
    _s_kernel = .;

    /* ********** 内核代码段 ********** */
    /** 
     *  内核代码段由 
     *      1. 启动代码段(只在内核启动阶段运行一次)
     *      2. 其余代码段(内核运行过程中可能多次运行)
     *  两部分组成
     */

    /* 内核引导段代码放在入口处 */
    _s_text_boot = .;
    .text.boot : {
        *(.text.boot)
    }
    _e_text_boot = .;

    /* 内核其余代码段依次排列, 内核其余代码8字节对齐 */
    . = ALIGN(8);
    _s_text = .;
    .text : {
        *(.text)
    }
    . = ALIGN(4096);
    _e_text = .;

    /* 代码段之后就是数据段, 内核数据段4096字节对齐, 注意这里和`mm.c`中的`create_identical_mapping`里的page_align的对应 */


    /* ********** 内核数据段 ********** */
    /** 
     *  内核数据段由 
     *      1. 只读数据段, 存放字符常量这类只读数据
     *      2. 一般数据段, 存放一般的全局变量
     *      2. 静态数据段, 存放未初始化的全局变量
     *  三部分组成
     */

    /* 内核只读数据段 */
    _s_rodata = .;
    .rodata : AT(ADDR(.rodata)) {
        *(.rodata)
    }
    _e_rodata = .;

    /* 内核一般数据段 */
    _s_data = .;
    .data : {
        *(.data)
        . = ALIGN(4096);
        *(.data.init_task)
    }
    /* 物理页需要4096字节对齐, 这里4096字节对齐之后划分4096字节作为内核页目录表 */
    . = ALIGN(4096);
    kernel_pgd = .;
    . += 2 * 4096;
    kernel_pgd_end = .;
    _e_data = .;

    /* 内核静态数据段 */
    . = ALIGN(0x8);
    _s_bss = .;
    .bss : {
        *(.bss*)
    }
    _e_bss = .;
    _e_kernel = .;
}